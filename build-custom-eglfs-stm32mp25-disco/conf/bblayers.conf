## build-custom-eglfs-stm32mp25-disco/conf/bblayers.conf
```bitbake
# LAYER_CONF_VERSION is increased each time build/conf/bblayers.conf
# changes incompatibly
LCONF_VERSION = "7"
BBPATH = "${TOPDIR}"
BBFILES ?= ""
OEROOT := "${@os.path.abspath(os.path.dirname(d.getVar('FILE')) + '/../..')}"


#--------------------------
# Layers var definition for buildsystem
#
OPENEMBEDDED = "${OPENEMBEDDED_NON_REMOVABLE}"

OPENEMBEDDED_NON_REMOVABLE = "${OEROOT}/layers/openembedded-core/meta"

POKY  = "${POKY_NON_REMOVABLE}"
POKY += "${OEROOT}/layers/poky/meta-yocto-bsp"

POKY_NON_REMOVABLE  = "${OEROOT}/layers/poky/meta"
#--------------------------
#
BBPATH = "${TOPDIR}"
BBFILES ?= ""

BBLAYERS += " \
  ${OEROOT}/layers/openembedded-core/meta \
  ${OEROOT}/layers/meta-openembedded/meta-gnome \
  ${OEROOT}/layers/meta-openembedded/meta-multimedia \
  ${OEROOT}/layers/meta-openembedded/meta-networking \
  ${OEROOT}/layers/meta-openembedded/meta-webserver \
"
# BSP dependencies"
BBLAYERS =+ "${OEROOT}/layers/meta-openembedded/meta-oe"
BBLAYERS =+ "${OEROOT}/layers/meta-openembedded/meta-python"
BBLAYERS =+ "${OEROOT}/layers/meta-st/meta-st-openstlinux"

# specific bsp selected
BBLAYERS =+ "${OEROOT}/layers/meta-st/meta-st-stm32mp"


# BSP dependencies"
#BBLAYERS =+ "${OEROOT}/layers/meta-openembedded/meta-oe"
#BBLAYERS =+ "${OEROOT}/layers/meta-openembedded/meta-python"
BBLAYERS += "${OEROOT}/layers/meta-custom-layer"
```

## build-customweston-stm32mp25-disco/conf/bblayers.conf
```bitbake
# LAYER_CONF_VERSION is increased each time build/conf/bblayers.conf
# changes incompatibly
LCONF_VERSION = "7"

BBPATH = "${TOPDIR}"
BBFILES ?= ""

LAYERS_PATH= "${TOPDIR}/.."

BBLAYERS += " \
  ${LAYERS_PATH}/layers/openembedded-core/meta \
  ${LAYERS_PATH}/layers/meta-openembedded/meta-gnome \
  ${LAYERS_PATH}/layers/meta-openembedded/meta-multimedia \
  ${LAYERS_PATH}/layers/meta-openembedded/meta-networking \
  ${LAYERS_PATH}/layers/meta-openembedded/meta-webserver \
"
# BSP dependencies"
BBLAYERS =+ "${LAYERS_PATH}/layers/meta-openembedded/meta-oe"
BBLAYERS =+ "${LAYERS_PATH}/layers/meta-openembedded/meta-python"
BBLAYERS =+ "${LAYERS_PATH}/layers/meta-st/meta-st-openstlinux"

# specific bsp selected
BBLAYERS =+ "${LAYERS_PATH}/layers/meta-st/meta-st-stm32mp"
#add QT
BBLAYERS += "${LAYERS_PATH}/layers/meta-qt5"
#BBLAYERS += "${OEROOT}/layers/meta-st/meta-st-x-linux-qt"

# BSP dependencies"
#BBLAYERS =+ "${OEROOT}/layers/meta-openembedded/meta-oe"
#BBLAYERS =+ "${OEROOT}/layers/meta-openembedded/meta-python"
BBLAYERS += "${LAYERS_PATH}/layers/meta-custom-layer"
```

## layers/meta-custom-layer/conf/distro/custom-weston.conf
```bitbake
#based on openstlinux-weston
#@NAME: custom-weston
#@DESCRIPTION: OpenSTLinux featuring Weston/Wayland (with GPLv3 software)

#inherit openstlinux-weston distribution
require conf/distro/openstlinux-weston.conf

# =========================================================================
# Distribution definition for: st-openstlinux-weston-
# =========================================================================
DISTRO = "custom-weston"
DISTRO_NAME = "NK custom - Weston - (A Yocto Project Based Distro)"

# =========================================================================
# DISTRO features
# =========================================================================
DISTRO_FEATURES:append = " opengl"
DISTRO_FEATURES:remove = " x11 "
# with X11
#PREFERRED_PROVIDER_virtual/xserver = "${@bb.utils.contains('DISTRO_FEATURES', 'x11 wayland', 'xwayland', 'xserver-xorg', d)}"

DISTRO_FEATURES:append = " gplv3 "

# activate GPU Vulkan & opencl
#DISTRO_FEATURES:append = " ${@bb.utils.filter('MACHINE_FEATURES', 'vulkan opencl', d)} "
```

## layers/meta-custom-layer/conf/distro/openstlinux-eglfs.conf
```bitbake
#@NAME: openstlinux-eglfs
#@DESCRIPTION: OpenSTLinux featuring eglfs - no X11, no Wayland (with GPLv3 software)

require conf/distro/include/st-default-distro-rules.inc
require conf/distro/include/st-default-distro-providers.inc
require conf/distro/include/openstlinux.inc

# =========================================================================
# Distribution definition for: st-openstlinux-eglfs
# =========================================================================
DISTRO = "openstlinux-eglfs"
DISTRO_NAME = "ST OpenSTLinux - EGLfs - (A Yocto Project Based Distro)"

# =========================================================================
# DISTRO features
# =========================================================================
DISTRO_FEATURES:append = " opengl egl"
DISTRO_FEATURES:remove = " wayland x11 vulkan"


DISTRO_FEATURES:append = " gplv3 "




# FOR QT5 FORCE GIT PROTOCOL FOR HTTPS
#QT_GIT_PROTOCOL = "https"
```

## layers/meta-custom-layer/conf/machine/my-stm32mp25-disco.conf
```bitbake
require conf/machine/stm32mp25-disco.conf


#remove features not required
MACHINE_FEATURES:remove = " alsa"
MACHINE_FEATURES:remove = " ext2"
MACHINE_FEATURES:remove = " pci"
MACHINE_FEATURES:remove = " bluetooth"
MACHINE_FEATURES:remove = " wifi"
MACHINE_FEATURES:remove = " m33copro"
MACHINE_FEATURES:remove = " m0copro"


#add config to generate wic files, no need  
WKS_IMAGE_FSTYPES += " wic wic.bz2 wic.bmap"
#WKS_FILE += "${OPTEE_WIC_FILE}"
WKS_FILE += " my_sdcard-stm32mp257f-dk-optee-vendorfs-2GB.wks.in"


#set max size
IMAGE_ROOTFS_SIZE = "131072"
IMAGE_ROOTFS_MAXSIZE = "4145728"
```
